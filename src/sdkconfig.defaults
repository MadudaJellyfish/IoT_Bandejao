## src/sdkconfig.defaults
```kconfig
CONFIG_ESPTOOLPY_FLASHSIZE_8MB=y
CONFIG_PARTITION_TABLE_CUSTOM=y
CONFIG_PARTITION_TABLE_CUSTOM_FILENAME="partitions.csv"
CONFIG_ESP_CHIP_ESP32S3=y
CONFIG_ESP32S3_DEFAULT_CPU_FREQ_240=y
CONFIG_IDF_TARGET_ESP32S3=y
CONFIG_SPIRAM_MODE_OCT=y
CONFIG_SPIRAM_TYPE_AUTO=y
CONFIG_SPIRAM_SPEED_80M=y
CONFIG_SPIRAM_SPEED=80
CONFIG_SPIRAM_USE_MALLOC=y
CONFIG_SPIRAM_MALLOC_RESERVE_INTERNAL=16384
CONFIG_SPIRAM_MALLOC_ALWAYSINTERNAL=0
CONFIG_SPIRAM_CACHE_WORKAROUND=y
CONFIG_CAMERA_MODEL_ESP32S3_EYE=y
CONFIG_CAMERA_MODULE_ESP_EYE=y
CONFIG_SCCB_CLK_FREQ=400000
CONFIG_ESP_FACE_DETECT_APP_USE_PSRAM=y
CONFIG_ESP_FACE_DETECT_ENABLED=y
CONFIG_ESP_TASK_WDT_STACK_SIZE_4K=y
CONFIG_ESP_MAIN_TASK_STACK_SIZE=3584
CONFIG_ESP_MINIMAL_SHARED_STACK_SIZE=2048
CONFIG_FREERTOS_UNICORE=n
CONFIG_FREERTOS_HZ=1000
CONFIG_FREERTOS_TASK_FUNCTION_WRAPPER=y
CONFIG_COMPILER_OPTIMIZATION_DEFAULT=y
CONFIG_COMPILER_OPTIMIZATION_ASSERTIONS_ENABLED=y
CONFIG_COMPILER_CXX_EXCEPTIONS=y
CONFIG_COMPILER_CXX_RTTI=y
CONFIG_LOG_DEFAULT_LEVEL=3
CONFIG_LOG_MAXIMUM_LEVEL=4
CONFIG_SECURE_BOOT_ENABLED=n
CONFIG_FLASH_ENCRYPTION_ENABLED=n
CONFIG_ESP32_SPIRAM_SUPPORT=y
```
